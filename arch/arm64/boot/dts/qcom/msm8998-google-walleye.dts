// SPDX-License-Identifier: GPL-2.0-only
/*
 * Copyright (c) 2020, Caleb Connolly <caleb@connolly.tech>
 */

/dts-v1/;

#include "msm8998-google-wahoo.dtsi"

/ {
	model = "Google Pixel 2";
	compatible = "google,walleye", "google,wahoo", "qcom,msm8998", "qcom,msm8998-mtp";
};
